## CMakeLists.txt
```
# SPDX-License-Identifier: Apache-2.0

cmake_minimum_required(VERSION 3.13.1)
include($ENV{ZEPHYR_BASE}/../pinetime/cmake/boilerplate.cmake)
include($ENV{ZEPHYR_BASE}/cmake/app/boilerplate.cmake NO_POLICY_SCOPE)
project(pinetime_app)

# use this approach
#FILE(GLOB app_sources src/*.c)
#target_sources(app PRIVATE ${app_sources})

target_sources(app PRIVATE src/main.c src/display.c src/date_time.c)
```

## prj.conf
```kconfig
CONFIG_HEAP_MEM_POOL_SIZE=16384

CONFIG_GPIO=y
CONFIG_SPI=y
CONFIG_COUNTER=y
CONFIG_COUNTER_RTC2=y

# Display
CONFIG_DISPLAY=y
CONFIG_ST7789V=y
CONFIG_ST7789V_RGB565=y
CONFIG_LVGL=y
CONFIG_LVGL_OBJ_LABEL=y
CONFIG_LVGL_BITS_PER_PIXEL=24
CONFIG_LVGL_HOR_RES=240
CONFIG_LVGL_VER_RES=240
CONFIG_LVGL_DISPLAY_DEV_NAME="DISPLAY"
CONFIG_LVGL_BUILD_IN_FONT_ROBOTO_28=y
CONFIG_LVGL_DEFAULT_FONT_BUILD_IN_ROBOTO_28=y
CONFIG_LVGL_OBJ_LABEL=y
CONFIG_LVGL_COLOR_DEPTH_16=y
CONFIG_LVGL_COLOR_16_SWAP=y
```

## src/main.c
```c
#include <device.h>
#include <drivers/display.h>
#include <lvgl.h>
#include <zephyr.h>
#include <drivers/gpio.h>
#include "display.h"
#include "date_time.h"

#define STACK_SIZE_LVGL 1024
#define LVGL_PRIORITY 5

K_THREAD_STACK_DEFINE(lvgl_stack, STACK_SIZE_LVGL);
struct k_thread thread_lvgl_data;

#define STACK_SIZE_MAIN_SCREEN_TIME 1024
#define MAIN_SCREEN_TIME_PRIORITY 5

K_THREAD_STACK_DEFINE(main_screen_time_stack, STACK_SIZE_MAIN_SCREEN_TIME);
struct k_thread thread_main_screen_time;

#define STACK_SIZE_MAIN_SCREEN_DATE 1024
#define MAIN_SCREEN_DATE_PRIORITY 5

K_THREAD_STACK_DEFINE(main_screen_date_stack, STACK_SIZE_MAIN_SCREEN_DATE);
struct k_thread thread_main_screen_date;

extern date_time_module curr_date_time;

void main(void)
{
    int rc = 0;

    rc = display_dev_init(&disp_dev);
    __ASSERT_NO_MSG(rc == 0);

    rc = display_backlight_init(&backlight_dev);
    __ASSERT_NO_MSG(rc == 0);

    date_time_init(&curr_date_time);
    rtc_counter_dev_init(&curr_date_time);

    /* Timer for LVGL tick - required for the internal timing of LittlevGL */
    k_timer_init(&lvgl_tick_timer, lvgl_tick_timer_expiry, NULL);
    /* Call lv_tick_inc() every 10ms */
    k_timer_start(&lvgl_tick_timer, K_MSEC(LV_TICK_INC_PERIOD_MS), K_MSEC(LV_TICK_INC_PERIOD_MS));

    lvgl_screens_create(&curr_date_time);
    display_blanking_off(disp_dev);

    k_thread_create(&thread_lvgl_data, lvgl_stack, K_THREAD_STACK_SIZEOF(lvgl_stack),
            lvgl_task_handler_run, NULL, NULL, NULL, LVGL_PRIORITY, 0, K_NO_WAIT);
    k_thread_create(&thread_main_screen_time, main_screen_time_stack, K_THREAD_STACK_SIZEOF(main_screen_time_stack),
            main_screen_time, NULL, NULL, NULL, MAIN_SCREEN_TIME_PRIORITY, 0, K_NO_WAIT);
    k_thread_create(&thread_main_screen_date, main_screen_date_stack, K_THREAD_STACK_SIZEOF(main_screen_date_stack),
            main_screen_date, NULL, NULL, NULL, MAIN_SCREEN_DATE_PRIORITY, 0, K_NO_WAIT);
}
```

## src/date_time.c
```c
#include <drivers/counter.h>
#include <sys/timeutil.h>
#include <string.h>
#include "date_time.h"

const char *months_str[MONTHS_NUM] = {
    "January",
    "February",
    "March",
    "April",
    "May",
    "June",
    "July",
    "August",
    "September",
    "October",
    "November",
    "December"
};

const char *wkdays_str[WKDAYS_NUM] = {
    "Sun",
    "Mon",
    "Tue",
    "Wed",
    "Thu",
    "Fri",
    "Sat"
};

date_time_module curr_date_time = {0};

void date_time_init(date_time_module *date_time_mod)
{
    k_mutex_init(&date_time_mod->mutex);

    /* Set Mon 1, 2020 at 12:00 */
    date_time_mod->time_civil_tm.tm_sec = 57;
    date_time_mod->time_civil_tm.tm_min = 59;
    date_time_mod->time_civil_tm.tm_hour = 23;
    date_time_mod->time_civil_tm.tm_mday = 1;
    date_time_mod->time_civil_tm.tm_mon = JAN;
    date_time_mod->time_civil_tm.tm_year = 2021 - 1900;
    date_time_mod->time_civil_tm.tm_wday = FRI;
    date_time_mod->time_civil_tm.tm_yday = 1;
    date_time_mod->time_civil_tm.tm_isdst = -1;

    /* Convert civil time to epoch time */
    date_time_mod->time_epoch_s = timeutil_timegm(&curr_date_time.time_civil_tm);
}

void rtc_alarm_cb(struct device *dev, u8_t chan_id, u32_t ticks, void *user_data)
{
    struct tm *civil_time = NULL;

    k_mutex_lock(&curr_date_time.mutex, K_MSEC(100));
    ++curr_date_time.time_epoch_s;
    /* Convert epoch time to civil */
    civil_time = gmtime(&curr_date_time.time_epoch_s);
    memcpy(&curr_date_time.time_civil_tm, civil_time, sizeof(struct tm));
    k_mutex_unlock(&curr_date_time.mutex);

    counter_set_channel_alarm(dev, 0, &curr_date_time.rtc_config);
}

int rtc_counter_dev_init(date_time_module *date_time_mod)
{
    date_time_mod->rtc_counter_dev = device_get_binding(DT_NORDIC_NRF_RTC_RTC_2_LABEL);
    if (date_time_mod->rtc_counter_dev == NULL) 
        return -EINVAL;

    counter_start(date_time_mod->rtc_counter_dev);

    date_time_mod->rtc_config.flags = 0;
    date_time_mod->rtc_config.ticks = counter_us_to_ticks(date_time_mod->rtc_counter_dev, RTC_ALARM_PERIOD_MS * USEC_PER_MSEC);
    date_time_mod->rtc_config.callback = rtc_alarm_cb;
    date_time_mod->rtc_config.user_data = NULL;

    counter_set_channel_alarm(date_time_mod->rtc_counter_dev, 0, &date_time_mod->rtc_config);

    return 0;
}
```

## src/date_time.h
```c
#ifndef _DATE_TIME_H
#define _DATE_TIME_H
#include <time.h>
#include <counter.h>

#define RTC_ALARM_PERIOD_MS 1000

#define SEC_TO_MS    1000
#define HOUR_TO_SECS 3600
#define HOUR_TO_MINS 60
#define DAY_TO_HOURS 24
#define DAY_TO_SECS (DAY_TO_HOURS * HOUR_TO_SECS)

typedef struct {
    struct device *rtc_counter_dev;
    struct counter_alarm_cfg rtc_config;
    struct tm time_civil_tm;
    time_t time_epoch_s;
    struct k_mutex mutex;
} date_time_module;

enum months {
    JAN = 0,
    FEB,
    MAR,
    APR,
    MAY,
    JUN,
    JUL,
    AUG,
    SEP,
    OCT,
    NOV,
    DEC,
    MONTHS_NUM
};

enum wkdays {
    SUN = 0,
    MON,
    TUE,
    WED,
    THU,
    FRI,
    SAT,
    WKDAYS_NUM
};

extern const char *months_str[MONTHS_NUM];
extern const char *wkdays_str[WKDAYS_NUM];

void date_time_init(date_time_module *date_time_mod);
void rtc_alarm_cb(struct device *dev, u8_t chan_id, u32_t ticks, void *user_data);
int rtc_counter_dev_init(date_time_module *date_time_mod);

#endif /* _DATE_TIME_H */
```

## src/display.c
```c
#include <kernel.h>
#include <drivers/gpio.h>
#include <drivers/display.h>
#include <lvgl.h>
#include <sys/util.h>
#include "display.h"
#include "date_time.h"

#define DATE_BUF_LEN 30

struct device *disp_dev = NULL;
struct device *backlight_dev = NULL;
struct k_mutex lvgl_mutex;
lv_obj_t *lvgl_main_screen_objs[OBJS_NUM] = {NULL};
struct k_timer lvgl_tick_timer;
extern date_time_module curr_date_time;

/* Thread for periodical lv_task_handler() call */
void lvgl_task_handler_run(void *arg1, void *arg2, void *arg3)
{
    ARG_UNUSED(arg1);
    ARG_UNUSED(arg2);
    ARG_UNUSED(arg3);

    while (1) {
        k_mutex_lock(&lvgl_mutex, K_FOREVER);
        lv_task_handler();
        k_mutex_unlock(&lvgl_mutex);
        k_sleep(5);
    }
}

/* Thread for displaying time on a main screen */
void main_screen_time(void *arg1, void *arg2, void *arg3)
{
    ARG_UNUSED(arg1);
    ARG_UNUSED(arg2);
    ARG_UNUSED(arg3);

    date_time_module date_time_temp;

    while (1) {
        k_mutex_lock(&curr_date_time.mutex, K_FOREVER);
        memcpy(&date_time_temp, &curr_date_time, sizeof(date_time_module));
        k_mutex_unlock(&curr_date_time.mutex);

        k_mutex_lock(&lvgl_mutex, K_FOREVER);
        lv_label_set_text_fmt(lvgl_main_screen_objs[TIME_LABEL], "%02d : %02d : %02d", date_time_temp.time_civil_tm.tm_hour,
                                                                                       date_time_temp.time_civil_tm.tm_min,
                                                                                       date_time_temp.time_civil_tm.tm_sec);
        k_mutex_unlock(&lvgl_mutex);
        k_sleep(200);
    }
}

/* Thread for displaying date on a main screen */
void main_screen_date(void *arg1, void *arg2, void *arg3)
{
    ARG_UNUSED(arg1);
    ARG_UNUSED(arg2);
    ARG_UNUSED(arg3);

    date_time_module date_time_temp;
    int current_wday = -1, next_date_change_secs;
    char date_buf[DATE_BUF_LEN] = {0};

    while (1) {
        k_mutex_lock(&curr_date_time.mutex, K_FOREVER);
        memcpy(&date_time_temp, &curr_date_time, sizeof(date_time_module));
        k_mutex_unlock(&curr_date_time.mutex);

        k_mutex_lock(&lvgl_mutex, K_FOREVER);
        if (current_wday != date_time_temp.time_civil_tm.tm_wday) {
            tm_to_date_str(&date_time_temp.time_civil_tm, date_buf, DATE_BUF_LEN);
            lv_label_set_text_fmt(lvgl_main_screen_objs[DATE_LABEL], "%s\n", date_buf);
        }
        /* Compute how many secs left to next date change */
        next_date_change_secs = DAY_TO_SECS - (date_time_temp.time_civil_tm.tm_hour * HOUR_TO_SECS) -
                                (date_time_temp.time_civil_tm.tm_min * HOUR_TO_MINS) - date_time_temp.time_civil_tm.tm_sec;
        current_wday = date_time_temp.time_civil_tm.tm_wday;
        k_mutex_unlock(&lvgl_mutex);
        /* Put this thread into sleep until next plannig date change */
        k_sleep(next_date_change_secs * SEC_TO_MS);
    }
}

int display_backlight_init(struct device **dev)
{
    *dev = device_get_binding(LED_PORT);
    if (*dev == NULL)
        return -EINVAL;

    gpio_pin_configure(*dev, LED, GPIO_DIR_OUT);
    gpio_pin_write(*dev, LED, 0);

    return 0;
}

int display_dev_init(struct device **dev)
{
    *dev = device_get_binding(CONFIG_LVGL_DISPLAY_DEV_NAME);
    if (*dev == NULL)
        return -EINVAL;
    else
        return 0;
}

void lvgl_screens_create(date_time_module *date_time_mod)
{
    k_mutex_init(&lvgl_mutex);

    static lv_style_t main_screen_st;
    lv_style_copy(&main_screen_st, &lv_style_plain);
    main_screen_st.body.main_color = LV_COLOR_BLACK;
    main_screen_st.body.grad_color = LV_COLOR_BLACK;

    lv_obj_t *main_scr = lv_scr_act();
    lvgl_main_screen_objs[MAIN_SCR] = main_scr;
    lv_obj_set_style(main_scr, &main_screen_st);

    /* TIME label */
    lv_obj_t *time_label = lv_label_create(lv_scr_act(), NULL);
    lvgl_main_screen_objs[TIME_LABEL] = time_label;
    lv_label_set_align(time_label, LV_LABEL_ALIGN_CENTER);
    lv_label_set_text_fmt(time_label, "%02d : %02d : %02d", date_time_mod->time_civil_tm.tm_hour,
                                                            date_time_mod->time_civil_tm.tm_min,
                                                            date_time_mod->time_civil_tm.tm_sec);

    static lv_style_t time_label_style;
    lv_style_copy(&time_label_style, &lv_style_plain);
    time_label_style.text.color = LV_COLOR_MAGENTA;
    time_label_style.text.font = &lv_font_roboto_28;

    lv_obj_set_style(time_label, &time_label_style);

    lv_obj_set_size(time_label, 80, 70);
    lv_obj_align(time_label, NULL, LV_ALIGN_CENTER, 0, -20);

    /* DATE label */
    lv_obj_t *date_label = lv_label_create(lv_scr_act(), NULL);
    lvgl_main_screen_objs[DATE_LABEL] = date_label;
    lv_label_set_align(date_label, LV_LABEL_ALIGN_CENTER);
    char date_buf[30] = {0};
    tm_to_date_str(&date_time_mod->time_civil_tm, date_buf, 30);
    lv_label_set_text_fmt(date_label, "%s", date_buf);

    static lv_style_t date_label_style;
    lv_style_copy(&date_label_style, &lv_style_plain);
    date_label_style.text.color = LV_COLOR_GREEN;
    date_label_style.text.font = &lv_font_roboto_28;

    lv_obj_set_style(date_label, &date_label_style);

    lv_obj_set_size(date_label, 80, 70);
    lv_obj_align(date_label, time_label, LV_ALIGN_OUT_BOTTOM_MID, 0 , 0);
}

void lvgl_tick_timer_expiry(struct k_timer *timer_id)
{
    ARG_UNUSED(timer_id);

    lv_tick_inc(LV_TICK_INC_PERIOD_MS);
}

char *tm_to_date_str(struct tm *time_date, char *time_buf, int len)
{
    char temp[5] = {0};

    strncpy(time_buf, wkdays_str[time_date->tm_wday], len);
    strncat(time_buf, ", ", len);
    u8_to_dec(temp, sizeof(temp), (u8_t)time_date->tm_mday);
    strncat(time_buf, temp, len);
    strncat(time_buf, " ", len);
    strncat(time_buf, months_str[time_date->tm_mon], len);

    return time_buf;
}
```

## src/display.h
```c
#ifndef _DISPLAY_H
#define _DISPLAY_H
#include "date_time.h"

#define LED_PORT DT_ALIAS_LED1_GPIOS_CONTROLLER
#define LED      DT_ALIAS_LED1_GPIOS_PIN

#define LV_TICK_INC_PERIOD_MS 10

enum lvgl_main_screen_objs {
    MAIN_SCR = 0,
    TIME_LABEL,
    DATE_LABEL,
    OBJS_NUM
};

extern struct device *disp_dev;
extern struct device *backlight_dev;
extern struct k_mutex lvgl_mutex;
extern lv_obj_t *lvgl_main_screen_objs[OBJS_NUM];
extern struct k_timer lvgl_tick_timer;

void lvgl_task_handler_run(void *arg1, void *arg2, void *arg3);
void main_screen_time(void *arg1, void *arg2, void *arg3);
void main_screen_date(void *arg1, void *arg2, void *arg3);
int display_backlight_init(struct device **dev);
int display_dev_init(struct device **dev);
void lvgl_screens_create(date_time_module *date_time_mod);
void lvgl_tick_timer_expiry(struct k_timer *timer_id);
char *tm_to_date_str(struct tm *time_date, char *time_buf, int len);

#endif /* _DISPLAY_H */
```
