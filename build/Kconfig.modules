## build/Kconfig.modules
```kconfig
osource "/Users/piotrek/Desktop/PineTime_repo/pinetime/Kconfig.pinetime"

osource "/Users/piotrek/Desktop/PineTime_repo/nrf/Kconfig.nrf"

osource "/Users/piotrek/Desktop/PineTime_repo/bootloader/mcuboot/zephyr/Kconfig"

osource "/Users/piotrek/Desktop/PineTime_repo/nrfxlib/Kconfig.nrfxlib"
```
